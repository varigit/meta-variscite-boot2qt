## conf/distro/include/imx6ul-var-dart.conf
```bitbake
include conf/distro/include/variscite.inc

DEPLOY_CONF_NAME = "Variscite DART-6UL"

PREFERRED_PROVIDER_virtual/egl = "opengldummy"
PREFERRED_PROVIDER_virtual/libgles2 = "opengldummy"

DISTRO_FEATURES_remove = "wayland"
```

## conf/distro/include/imx7-var-som.conf
```bitbake
include conf/distro/include/variscite.inc

DEPLOY_CONF_NAME = "Variscite VAR-SOM-MX7"

PREFERRED_PROVIDER_virtual/egl = "opengldummy"
PREFERRED_PROVIDER_virtual/libgles2 = "opengldummy"

DISTRO_FEATURES_remove = "webengine wayland"
```

## conf/distro/include/jetson.inc
```bitbake
############################################################################
##
## Copyright (C) 2017 The Qt Company Ltd.
## Contact: https://www.qt.io/licensing/
##
## This file is part of the Boot to Qt meta layer.
##
## $QT_BEGIN_LICENSE:GPL$
## Commercial License Usage
## Licensees holding valid commercial Qt licenses may use this file in
## accordance with the commercial license agreement provided with the
## Software or, alternatively, in accordance with the terms contained in
## a written agreement between you and The Qt Company. For licensing terms
## and conditions see https://www.qt.io/terms-conditions. For further
## information use the contact form at https://www.qt.io/contact-us.
##
## GNU General Public License Usage
## Alternatively, this file may be used under the terms of the GNU
## General Public License version 3 or (at your option) any later version
## approved by the KDE Free Qt Foundation. The licenses are as published by
## the Free Software Foundation and appearing in the file LICENSE.GPL3
## included in the packaging of this file. Please review the following
## information to ensure the GNU General Public License requirements will
## be met: https://www.gnu.org/licenses/gpl-3.0.html.
##
## $QT_END_LICENSE$
##
############################################################################

PREFERRED_PROVIDER_libdrm-tegra = "libdrm-tegra"

# use mmc0
ROOTFS_DEVICE = "mmcblk1p1"

INITRAMFS_MAXSIZE = "165888"
IMAGE_CLASSES += "image_types_tegra"
IMAGE_FSTYPES += "tegraflash"
IMAGE_ROOTFS_ALIGNMENT = "1024"
UBOOT_SUFFIX = "bin"

QBSP_IMAGE_CONTENT = "\
    ${IMAGE_LINK_NAME}.img \
    ${IMAGE_LINK_NAME}.conf \
    "
```

## conf/distro/include/nitrogen6x.conf
```bitbake
############################################################################
##
## Copyright (C) 2016 The Qt Company Ltd.
## Contact: https://www.qt.io/licensing/
##
## This file is part of the Boot to Qt meta layer.
##
## $QT_BEGIN_LICENSE:GPL$
## Commercial License Usage
## Licensees holding valid commercial Qt licenses may use this file in
## accordance with the commercial license agreement provided with the
## Software or, alternatively, in accordance with the terms contained in
## a written agreement between you and The Qt Company. For licensing terms
## and conditions see https://www.qt.io/terms-conditions. For further
## information use the contact form at https://www.qt.io/contact-us.
##
## GNU General Public License Usage
## Alternatively, this file may be used under the terms of the GNU
## General Public License version 3 or (at your option) any later version
## approved by the KDE Free Qt Foundation. The licenses are as published by
## the Free Software Foundation and appearing in the file LICENSE.GPL3
## included in the packaging of this file. Please review the following
## information to ensure the GNU General Public License requirements will
## be met: https://www.gnu.org/licenses/gpl-3.0.html.
##
## $QT_END_LICENSE$
##
############################################################################

include conf/distro/include/fsl.inc
include conf/distro/include/opencv.inc

DEPLOY_CONF_NAME = "Boundary Devices i.MX6"

BOOT_SPACE = "16384"
BOOT_SCRIPTS += "6x_upgrade-${MACHINE}:6x_upgrade \
                 u-boot-nit6xlite-*.imx:u-boot.nit6xlite \
                 u-boot-nit6xlite1g-*.imx:u-boot.nit6xlite1g \
                 u-boot-nitrogen6dl-*.imx:u-boot.nitrogen6dl \
                 u-boot-nitrogen6dl2g-*.imx:u-boot.nitrogen6dl2g \
                 u-boot-nitrogen6q2g-*.imx:u-boot.nitrogen6q2g \
                 u-boot-nitrogen6q-*.imx:u-boot.nitrogen6q \
                 u-boot-nitrogen6q_fl-*.imx:u-boot.nitrogen6q_fl \
                 u-boot-nitrogen6qp_max-*.imx:u-boot.nitrogen6qp_max \
                 u-boot-nitrogen6s1g-*.imx:u-boot.nitrogen6s1g \
                 u-boot-nitrogen6s-*.imx:u-boot.nitrogen6s \
                 u-boot-nitrogen6sx-*.imx:u-boot.nitrogen6sx \
                 u-boot-nitrogen6_lum_dl1-*.imx:u-boot.nitrogen6_lum_dl1 \
                 u-boot-nitrogen6_max-*.imx:u-boot.nitrogen6_max \
                 u-boot-nitrogen6_vm1g-*.imx:u-boot.nitrogen6_vm1g \
                 u-boot-nitrogen6_vm-*.imx:u-boot.nitrogen6_vm \
                "

UBOOT_MACHINE = ""
UBOOT_CONFIG ??= "nit6xlite nit6xlite1g \
                  nitrogen6dl nitrogen6dl2g \
                  nitrogen6q2g nitrogen6q nitrogen6q_fl nitrogen6qp_max \
                  nitrogen6s1g nitrogen6s nitrogen6sx \
                  nitrogen6_lum_dl1 nitrogen6_max \
                  nitrogen6_vm1g nitrogen6_vm \
                 "

UBOOT_CONFIG[nit6xlite] = "nit6xlite_config"
UBOOT_CONFIG[nit6xlite1g] = "nit6xlite1g_config"
UBOOT_CONFIG[nitrogen6dl] = "nitrogen6dl_config"
UBOOT_CONFIG[nitrogen6dl2g] = "nitrogen6dl2g_config"
UBOOT_CONFIG[nitrogen6q2g] = "nitrogen6q2g_config"
UBOOT_CONFIG[nitrogen6q] = "nitrogen6q_config"
UBOOT_CONFIG[nitrogen6q_fl] = "nitrogen6q_fl_config"
UBOOT_CONFIG[nitrogen6qp_max] = "nitrogen6qp_max_config"
UBOOT_CONFIG[nitrogen6s1g] = "nitrogen6s1g_config"
UBOOT_CONFIG[nitrogen6s] = "nitrogen6s_config"
UBOOT_CONFIG[nitrogen6sx] = "nitrogen6sx_config"
UBOOT_CONFIG[nitrogen6_lum_dl1] = "nitrogen6_lum_dl1_config"
UBOOT_CONFIG[nitrogen6_max] = "nitrogen6_max_config"
UBOOT_CONFIG[nitrogen6_vm1g] = "nitrogen6_vm1g_config"
UBOOT_CONFIG[nitrogen6_vm] = "nitrogen6_vm_config"

EXTRA_IMAGEDEPENDS += "u-boot u-boot-script-boundary"

KERNEL_DEVICETREE += "\
    imx6dl-nit6xlite.dtb \
    "

MACHINE_EXTRA_INSTALL += "\
        bcm4330-nvram-config \
        "
```

## conf/distro/include/rcar-gen3.inc
```bitbake
############################################################################
##
## Copyright (C) 2017 The Qt Company Ltd.
## Contact: https://www.qt.io/licensing/
##
## This file is part of the Boot to Qt meta layer.
##
## $QT_BEGIN_LICENSE:GPL$
## Commercial License Usage
## Licensees holding valid commercial Qt licenses may use this file in
## accordance with the commercial license agreement provided with the
## Software or, alternatively, in accordance with the terms contained in
## a written agreement between you and The Qt Company. For licensing terms
## and conditions see https://www.qt.io/terms-conditions. For further
## information use the contact form at https://www.qt.io/contact-us.
##
## GNU General Public License Usage
## Alternatively, this file may be used under the terms of the GNU
## General Public License version 3 or (at your option) any later version
## approved by the KDE Free Qt Foundation. The licenses are as published by
## the Free Software Foundation and appearing in the file LICENSE.GPL3
## included in the packaging of this file. Please review the following
## information to ensure the GNU General Public License requirements will
## be met: https://www.gnu.org/licenses/gpl-3.0.html.
##
## $QT_END_LICENSE$
##
############################################################################

include conf/distro/include/fsl.inc

QBSP_IMAGE_CONTENT = "\
    ${IMAGE_LINK_NAME}.img \
    ${IMAGE_LINK_NAME}.conf \
    "

BOOT_SPACE = "16384"

# uncomment following if using the evaluation drivers
#DISTRO_FEATURES_append = " use_eva_pkg"

MACHINE_FEATURES_append = " gsx multimedia"

MULTI_PROVIDER_WHITELIST += "virtual/libgl virtual/egl virtual/libgles1 virtual/libgles2 virtual/libgbm"

#DISTRO_FEATURES_append = " pam"
PREFERRED_PROVIDER_virtual/libgles1 = ""
PREFERRED_PROVIDER_virtual/libgles2 = "gles-user-module"
PREFERRED_PROVIDER_virtual/egl = "gles-user-module"
PREFERRED_PROVIDER_virtual/libgl = ""
PREFERRED_PROVIDER_virtual/mesa = ""
PREFERRED_PROVIDER_libgbm = "libgbm"
PREFERRED_PROVIDER_libgbm-dev = "libgbm"
PREFERRED_PROVIDER_virtual/libgbm = "libgbm"
BBMASK += "mesa-gl"

# internal copy of R-Car_Series_Evaluation_Software_Packages used for CI
FILESEXTRAPATHS_append = "${BSPDIR}/sources/renesas-rcar-gen3/${PN}:"

BBMASK += "\
    meta-linaro/meta-optee/recipes-security/optee \
    meta-rcar-gen3/recipes-connectivity/ppp \
    meta-rcar-gen3/recipes-core/packagegroups \
    meta-rcar-gen3/recipes-graphics/mesa \
    meta-rcar-gen3/recipes-multimedia/gstreamer \
    meta-rcar-gen3/recipes-multimedia/webp \
    "
```

## conf/distro/include/tegra-t18x.conf
```bitbake
############################################################################
##
## Copyright (C) 2016 The Qt Company Ltd.
## Contact: https://www.qt.io/licensing/
##
## This file is part of the Boot to Qt meta layer.
##
## $QT_BEGIN_LICENSE:GPL$
## Commercial License Usage
## Licensees holding valid commercial Qt licenses may use this file in
## accordance with the commercial license agreement provided with the
## Software or, alternatively, in accordance with the terms contained in
## a written agreement between you and The Qt Company. For licensing terms
## and conditions see https://www.qt.io/terms-conditions. For further
## information use the contact form at https://www.qt.io/contact-us.
##
## GNU General Public License Usage
## Alternatively, this file may be used under the terms of the GNU
## General Public License version 3 or (at your option) any later version
## approved by the KDE Free Qt Foundation. The licenses are as published by
## the Free Software Foundation and appearing in the file LICENSE.GPL3
## included in the packaging of this file. Please review the following
## information to ensure the GNU General Public License requirements will
## be met: https://www.gnu.org/licenses/gpl-3.0.html.
##
## $QT_END_LICENSE$
##
############################################################################

OLDEST_KERNEL_aarch64 = "3.18"

TARGET_CFLAGS += " -DWIN_INTERFACE_CUSTOM"
DISTRO_FEATURES_DEFAULT += "wayland"
IMAGE_FSTYPES += "tar.gz"

QBSP_IMAGE_CONTENT = "\
    ${IMAGE_LINK_NAME}.tar.gz \
    Image \
    "

KERN_DIR ?= '${@os.path.normpath("${TOPDIR}/../sources/vibrante-t186/kernel")}'
PLATFORM_TOPDIR ?= '${@os.path.normpath("${TOPDIR}/../sources/vibrante-t186")}'
NVLAYER_DIR ?= "${TOPDIR}/../sources/nvidia-layer"

MACHINE_EXTRA_INSTALL += "\
    tegra-firmware-fecs \
    tegra-firmware-gmicrocode \
    tegra-firmware-gpccs \
    tegra-firmware-gpmu \
    tegra-firmware-gshader \
    tegra-firmware-pmu \
    tegra-firmware-prod-fuse \
    tegra-firmware-xusb \
    tegra-firmware-vic \
    tegra-firmware-nvdec \
    tegra-firmware-nvenc \
    tegra-firmware-nvjpeg \
    tegra-drivers \
    virtual/libegl \
    virtual/libgles2 \
    libdrm-nv \
    "

PREFERRED_PROVIDER_virtual/libgles2 ?= "tegra-drivers"
PREFERRED_PROVIDER_virtual/libgles2-dev ?= "tegra-drivers"
PREFERRED_PROVIDER_virtual/libegl ?= "tegra-drivers"
PREFERRED_PROVIDER_virtual/libegl-dev ?= "tegra-drivers"
PREFERRED_PROVIDER_virtual/egl ?= "tegra-drivers"
PREFERRED_PROVIDER_virtual/libgl ?= "tegra-drivers"
PREFERRED_PROVIDER_virtual/libgles1 ?= "tegra-drivers"
PREFERRED_PROVIDER_virtual/mesa ?= "tegra-drivers"

BBMASK += "\
    meta-vib4/recipes-connectivity/connman \
    meta-vib4/recipes-core/toybox \
    meta-vib4/recipes-core/images \
    meta-vib4/recipes-core/packagegroups \
    meta-vib4/recipes-extended \
    meta-vib4/recipes-multimedia/audiomanager \
    meta-vib4/recipes-core/glibc \
    meta-vib4/recipes-support/lvm2 \
    meta-vib4/recipes-kernel/linux-libc-headers \
    meta-vib4/recipes-devtools/binutils \
    meta-vib4/recipes-yocto-ivi/packagegroups \
    meta-vib4/recipes-graphics/wayland/wayland-ivi-extension_%.bbappend \
    meta-vib4/recipes-graphics/wayland/libinput_%.bbappend \
    "
```

## conf/distro/include/var-som-mx6.conf
```bitbake
include conf/distro/include/variscite.inc

DEPLOY_CONF_NAME = "Variscite VAR-SOM-MX6"
```

## conf/machine/qemuarmv7.conf
```bitbake
#@TYPE: Machine
#@NAME: generic armv machine
#@DESCRIPTION: Machine configuration for running a generic armv7

DEFAULTTUNE = "armv7athf-neon"

require conf/machine/include/qemu.inc
require conf/machine/include/arm/arch-armv7a.inc
```

## meta-boot2qt-distro/conf/distro/b2qt.conf
```bitbake
############################################################################
##
## Copyright (C) 2021 The Qt Company Ltd.
## Contact: https://www.qt.io/licensing/
##
## This file is part of the Boot to Qt meta layer.
##
## $QT_BEGIN_LICENSE:GPL$
## Commercial License Usage
## Licensees holding valid commercial Qt licenses may use this file in
## accordance with the commercial license agreement provided with the
## Software or, alternatively, in accordance with the terms contained in
## a written agreement between you and The Qt Company. For licensing terms
## and conditions see https://www.qt.io/terms-conditions. For further
## information use the contact form at https://www.qt.io/contact-us.
##
## GNU General Public License Usage
## Alternatively, this file may be used under the terms of the GNU
## General Public License version 3 or (at your option) any later version
## approved by the KDE Free Qt Foundation. The licenses are as published by
## the Free Software Foundation and appearing in the file LICENSE.GPL3
## included in the packaging of this file. Please review the following
## information to ensure the GNU General Public License requirements will
## be met: https://www.gnu.org/licenses/gpl-3.0.html.
##
## $QT_END_LICENSE$
##
############################################################################

include conf/distro/poky.conf

DISTRO = "b2qt"
DISTRO_NAME = "Boot to Qt for Embedded Linux"
SDK_VERSION := "${DISTRO_VERSION}"

SDK_VENDOR:mingw32 = "-w64"
SDK_VENDOR:sdkmingw32 = "-w64"

SDK_MACHINE = "${@d.getVar('SDKMACHINE') or '${SDK_ARCH}'}"
SDK_NAME = "${DISTRO}-${SDK_MACHINE}-${IMAGE_BASENAME}"
TOOLCHAIN_OUTPUTNAME = "${SDK_NAME}-${MACHINE}"
BUILDCFG_VARS += "SDKMACHINE"

MAINTAINER = "B2Qt <b2qt@qt.io>"

SYSVINIT_ENABLED_GETTYS = ""

POKY_DEFAULT_DISTRO_FEATURES:remove = "ptest"
DISTRO_FEATURES_DEFAULT:remove = "irda pcmcia pci 3g nfc zeroconf x11"
DISTRO_FEATURES_BACKFILL_CONSIDERED = "sysvinit"

DISTRO_FEATURES_FILTER_NATIVESDK:append = " wayland"

FONTCONFIG_CACHE_DIR = "${libdir}/fontconfig/cache"

DISTRO_FEATURES += "gstreamer webengine systemd pam ld-is-gold"
DISTRO_FEATURES:remove:mipsarch = "webengine ld-is-gold"
DISTRO_FEATURES:remove:riscv64 = "webengine ld-is-gold"

INIT_MANAGER = "systemd"

PREFERRED_PROVIDER_jpeg ?= "libjpeg-turbo"
PREFERRED_PROVIDER_jpeg-native ?= "libjpeg-turbo-native"

IMAGE_FSTYPES += "conf"
IMAGE_CLASSES += "deploy-conf"

QBSP_README ?= "README"
QBSP_IMAGE_CONTENT ?= "${QBSP_README}"
QBSP_IMAGE_DEPENDS ?= "qbsp-readme:do_deploy"

LICENSE_CREATE_PACKAGE = "1"
COPY_LIC_MANIFEST = "1"

QT_EDITION = "commercial"

include conf/distro/include/b2qt.inc
include conf/distro/include/machine-settings.inc
include conf/distro/include/preferred-providers-${SDK_OS}.inc
```
