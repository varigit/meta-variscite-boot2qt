## meta-boot2qt-distro/conf/distro/include/nitrogen6x.conf
```bitbake
############################################################################
##
## Copyright (C) 2018 The Qt Company Ltd.
## Contact: https://www.qt.io/licensing/
##
## This file is part of the Boot to Qt meta layer.
##
## $QT_BEGIN_LICENSE:GPL$
## Commercial License Usage
## Licensees holding valid commercial Qt licenses may use this file in
## accordance with the commercial license agreement provided with the
## Software or, alternatively, in accordance with the terms contained in
## a written agreement between you and The Qt Company. For licensing terms
## and conditions see https://www.qt.io/terms-conditions. For further
## information use the contact form at https://www.qt.io/contact-us.
##
## GNU General Public License Usage
## Alternatively, this file may be used under the terms of the GNU
## General Public License version 3 or (at your option) any later version
## approved by the KDE Free Qt Foundation. The licenses are as published by
## the Free Software Foundation and appearing in the file LICENSE.GPL3
## included in the packaging of this file. Please review the following
## information to ensure the GNU General Public License requirements will
## be met: https://www.gnu.org/licenses/gpl-3.0.html.
##
## $QT_END_LICENSE$
##
############################################################################

include conf/distro/include/boundary.inc

DEPLOY_CONF_NAME = "Boundary Devices i.MX6"

BOOT_SPACE = "16384"
IMAGE_BOOT_FILES += "\
    upgrade.scr-${MACHINE};upgrade.scr \
    upgrade.scr-${MACHINE};6x_upgrade \
    u-boot-${MACHINE}.imx-nit6xlite;u-boot.nit6xlite \
    u-boot-${MACHINE}.imx-nit6xlite1g;u-boot.nit6xlite1g \
    u-boot-${MACHINE}.imx-nitrogen6dl;u-boot.nitrogen6dl \
    u-boot-${MACHINE}.imx-nitrogen6dl2g;u-boot.nitrogen6dl2g \
    u-boot-${MACHINE}.imx-nitrogen6q2g;u-boot.nitrogen6q2g \
    u-boot-${MACHINE}.imx-nitrogen6q;u-boot.nitrogen6q \
    u-boot-${MACHINE}.imx-nitrogen6q_fl;u-boot.nitrogen6q_fl \
    u-boot-${MACHINE}.imx-nitrogen6qp_max;u-boot.nitrogen6qp_max \
    u-boot-${MACHINE}.imx-nitrogen6s1g;u-boot.nitrogen6s1g \
    u-boot-${MACHINE}.imx-nitrogen6s;u-boot.nitrogen6s \
    u-boot-${MACHINE}.imx-nitrogen6sx;u-boot.nitrogen6sx \
    u-boot-${MACHINE}.imx-nitrogen6_lum_dl1;u-boot.nitrogen6_lum_dl1 \
    u-boot-${MACHINE}.imx-nitrogen6_max;u-boot.nitrogen6_max \
    u-boot-${MACHINE}.imx-nitrogen6_vm1g;u-boot.nitrogen6_vm1g \
    u-boot-${MACHINE}.imx-nitrogen6_vm;u-boot.nitrogen6_vm \
    "
WKS_FILE_DEPENDS += "u-boot"

UBOOT_MACHINE = ""
UBOOT_CONFIG ??= "nit6xlite nit6xlite1g \
                  nitrogen6dl nitrogen6dl2g \
                  nitrogen6q2g nitrogen6q nitrogen6q_fl nitrogen6qp_max \
                  nitrogen6s1g nitrogen6s nitrogen6sx \
                  nitrogen6_lum_dl1 nitrogen6_max \
                  nitrogen6_vm1g nitrogen6_vm \
                 "

UBOOT_CONFIG[nit6xlite] = "nit6xlite_config"
UBOOT_CONFIG[nit6xlite1g] = "nit6xlite1g_config"
UBOOT_CONFIG[nitrogen6dl] = "nitrogen6dl_config"
UBOOT_CONFIG[nitrogen6dl2g] = "nitrogen6dl2g_config"
UBOOT_CONFIG[nitrogen6q2g] = "nitrogen6q2g_config"
UBOOT_CONFIG[nitrogen6q] = "nitrogen6q_config"
UBOOT_CONFIG[nitrogen6q_fl] = "nitrogen6q_fl_config"
UBOOT_CONFIG[nitrogen6qp_max] = "nitrogen6qp_max_config"
UBOOT_CONFIG[nitrogen6s1g] = "nitrogen6s1g_config"
UBOOT_CONFIG[nitrogen6s] = "nitrogen6s_config"
UBOOT_CONFIG[nitrogen6sx] = "nitrogen6sx_config"
UBOOT_CONFIG[nitrogen6_lum_dl1] = "nitrogen6_lum_dl1_config"
UBOOT_CONFIG[nitrogen6_max] = "nitrogen6_max_config"
UBOOT_CONFIG[nitrogen6_vm1g] = "nitrogen6_vm1g_config"
UBOOT_CONFIG[nitrogen6_vm] = "nitrogen6_vm_config"

KERNEL_DEVICETREE += "\
    imx6dl-nit6xlite.dtb \
    "

MACHINE_EXTRA_INSTALL += "\
        bcm4330-nvram-config \
        "
```

## meta-boot2qt-distro/conf/distro/include/no-gpl3.inc
```bitbake
############################################################################
##
## Copyright (C) 2018 The Qt Company Ltd.
## Contact: https://www.qt.io/licensing/
##
## This file is part of the Boot to Qt meta layer.
##
## $QT_BEGIN_LICENSE:GPL$
## Commercial License Usage
## Licensees holding valid commercial Qt licenses may use this file in
## accordance with the commercial license agreement provided with the
## Software or, alternatively, in accordance with the terms contained in
## a written agreement between you and The Qt Company. For licensing terms
## and conditions see https://www.qt.io/terms-conditions. For further
## information use the contact form at https://www.qt.io/contact-us.
##
## GNU General Public License Usage
## Alternatively, this file may be used under the terms of the GNU
## General Public License version 3 or (at your option) any later version
## approved by the KDE Free Qt Foundation. The licenses are as published by
## the Free Software Foundation and appearing in the file LICENSE.GPL3
## included in the packaging of this file. Please review the following
## information to ensure the GNU General Public License requirements will
## be met: https://www.gnu.org/licenses/gpl-3.0.html.
##
## $QT_END_LICENSE$
##
############################################################################

# Configuration for boot2qt image without (L)GPLv3 components
# Include in your conf/local.conf and add meta-gplv2 layer to your configuration
# https://www.yoctoproject.org/docs/latest/mega-manual/mega-manual.html#migration-2.3-gplv2-and-gplv3-moves

INCOMPATIBLE_LICENSE += "*GPLv3"

IMAGE_FEATURES_remove_pn-b2qt-embedded-qt5-image = "tools-debug debug-tweaks"
IMAGE_FEATURES_remove_pn-b2qt-automotive-qt5-image = "tools-debug debug-tweaks"

RDEPENDS_packagegroup-b2qt-embedded-tools_remove_pn-packagegroup-b2qt-embedded-tools = "binutils binutils-symlinks perf"
RDEPENDS_packagegroup-b2qt-embedded-base_remove_pn-packagegroup-b2qt-embedded-base = "ttf-freefont-mono"

PACKAGECONFIG_remove_pn-qtvirtualkeyboard = "hunspell"
PACKAGECONFIG_remove_pn-python3-pygobject = "cairo"

# intel nuc specific changes
IMAGE_FSTYPES_intel-corei7-64 = "tar.gz"
MACHINE_EXTRA_INSTALL_remove_intel-corei7-64 = "grub-efi-config"
QBSP_IMAGE_CONTENT_intel-corei7-64 = ""
```

## meta-boot2qt-distro/conf/distro/include/preferred-providers-mingw32.inc
```bitbake
PREFERRED_PROVIDER_nativesdk-antlr4-python3-runtime ?= "nativesdk-prebuild-python"
PREFERRED_PROVIDER_nativesdk-python3 ?= "nativesdk-prebuild-python"
PREFERRED_PROVIDER_nativesdk-python3-jinja2 ?= "nativesdk-prebuild-python"
PREFERRED_PROVIDER_nativesdk-python3-markupsafe ?= "nativesdk-prebuild-python"
PREFERRED_PROVIDER_nativesdk-python3-path.py ?= "nativesdk-prebuild-python"
PREFERRED_PROVIDER_nativesdk-python3-pathtools ?= "nativesdk-prebuild-python"
PREFERRED_PROVIDER_nativesdk-qface ?= "nativesdk-prebuild-python"
PREFERRED_PROVIDER_nativesdk-python3-setuptools-scm ?= "nativesdk-prebuild-python"
PREFERRED_PROVIDER_nativesdk-python3-watchdog ?= "nativesdk-prebuild-python"
```
