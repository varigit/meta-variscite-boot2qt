## meta-boot2qt-distro/conf/distro/include/colibri-imx7.conf
```bitbake
############################################################################
##
## Copyright (C) 2016 The Qt Company Ltd.
## Contact: https://www.qt.io/licensing/
##
## This file is part of the Boot to Qt meta layer.
##
## $QT_BEGIN_LICENSE:GPL$
## Commercial License Usage
## Licensees holding valid commercial Qt licenses may use this file in
## accordance with the commercial license agreement provided with the
## Software or, alternatively, in accordance with the terms contained in
## a written agreement between you and The Qt Company. For licensing terms
## and conditions see https://www.qt.io/terms-conditions. For further
## information use the contact form at https://www.qt.io/contact-us.
##
## GNU General Public License Usage
## Alternatively, this file may be used under the terms of the GNU
## General Public License version 3 or (at your option) any later version
## approved by the KDE Free Qt Foundation. The licenses are as published by
## the Free Software Foundation and appearing in the file LICENSE.GPL3
## included in the packaging of this file. Please review the following
## information to ensure the GNU General Public License requirements will
## be met: https://www.gnu.org/licenses/gpl-3.0.html.
##
## $QT_END_LICENSE$
##
############################################################################

include conf/distro/include/toradex.inc

DEPLOY_CONF_NAME = "Toradex Colibri iMX7"

IMAGE_BOOT_FILES += " \
    u-boot-nand.imx;${MACHINEDIR}/u-boot-nand.imx \
    "

PREFERRED_PROVIDER_virtual/egl = "opengldummy"
PREFERRED_PROVIDER_virtual/libgles2 = "opengldummy"

DISTRO_FEATURES_remove = "webengine wayland vulkan"

BOOT2QT_DEMOS_remove = "boot2qt-demo-mediaplayer boot2qt-demo-qtgraphicaleffects boot2qt-demo-qtwebbrowser"

QT_USE_SOFTWARE_CONTEXT = "1"

# try to limit the maximum size of the tezi image
RDEPENDS_packagegroup-b2qt-embedded-base_remove_pn-packagegroup-b2qt-embedded-base = "linux-firmware"
```

## meta-boot2qt-distro/conf/distro/include/draak.conf
```bitbake
############################################################################
##
## Copyright (C) 2018 The Qt Company Ltd.
## Contact: https://www.qt.io/licensing/
##
## This file is part of the Boot to Qt meta layer.
##
## $QT_BEGIN_LICENSE:GPL$
## Commercial License Usage
## Licensees holding valid commercial Qt licenses may use this file in
## accordance with the commercial license agreement provided with the
## Software or, alternatively, in accordance with the terms contained in
## a written agreement between you and The Qt Company. For licensing terms
## and conditions see https://www.qt.io/terms-conditions. For further
## information use the contact form at https://www.qt.io/contact-us.
##
## GNU General Public License Usage
## Alternatively, this file may be used under the terms of the GNU
## General Public License version 3 or (at your option) any later version
## approved by the KDE Free Qt Foundation. The licenses are as published by
## the Free Software Foundation and appearing in the file LICENSE.GPL3
## included in the packaging of this file. Please review the following
## information to ensure the GNU General Public License requirements will
## be met: https://www.gnu.org/licenses/gpl-3.0.html.
##
## $QT_END_LICENSE$
##
############################################################################

include conf/distro/include/rcar-gen3.inc

DEPLOY_CONF_NAME = "Renesas R-Car-D3 (Draak)"

PREFERRED_PROVIDER_virtual/egl = "gles-user-module"
PREFERRED_VERSION_libdrm = "2.4.91"

KERNEL_DEVICETREE += "renesas/r8a77995-draak-lvds.dtb"

WKS_FILE_DEPENDS_remove = "optee-os"
QBSP_IMAGE_CONTENT_remove = "tee-${MACHINE}.srec"

BBMASK += "\
    meta-rcar-gen3/recipes-multimedia/webp \
    meta-rcar-gen3/recipes-connectivity/ppp \
    meta-rcar-gen3/recipes-graphics/wayland/wayland-protocols \
    meta-renesas/meta-rcar-gen3/recipes-graphics/drm \
    meta-rcar-gen3/recipes-multimedia/gstreamer \
    "
```

## meta-boot2qt-distro/conf/distro/include/fsl-imx8.inc
```bitbake
############################################################################
##
## Copyright (C) 2019 The Qt Company Ltd.
## Contact: https://www.qt.io/licensing/
##
## This file is part of the Boot to Qt meta layer.
##
## $QT_BEGIN_LICENSE:GPL$
## Commercial License Usage
## Licensees holding valid commercial Qt licenses may use this file in
## accordance with the commercial license agreement provided with the
## Software or, alternatively, in accordance with the terms contained in
## a written agreement between you and The Qt Company. For licensing terms
## and conditions see https://www.qt.io/terms-conditions. For further
## information use the contact form at https://www.qt.io/contact-us.
##
## GNU General Public License Usage
## Alternatively, this file may be used under the terms of the GNU
## General Public License version 3 or (at your option) any later version
## approved by the KDE Free Qt Foundation. The licenses are as published by
## the Free Software Foundation and appearing in the file LICENSE.GPL3
## included in the packaging of this file. Please review the following
## information to ensure the GNU General Public License requirements will
## be met: https://www.gnu.org/licenses/gpl-3.0.html.
##
## $QT_END_LICENSE$
##
############################################################################

include conf/distro/include/fsl.inc

FSL_EULA_FILE := "${COREBASE}/../meta-fsl-bsp-release/imx/EULA.txt"

DISTRO_FEATURES_remove = "vulkan"

PREFERRED_PROVIDER_virtual/bootloader_imx = "u-boot-imx"
PREFERRED_VERSION_linux-libc-headers_imx ?= "4.14"
PREFERRED_VERSION_gstreamer1.0-plugins-base = "1.14.4.imx"
PREFERRED_VERSION_gstreamer1.0-plugins-bad  = "1.14.4.imx"
PREFERRED_VERSION_gstreamer1.0-plugins-good = "1.14.4.imx"
PREFERRED_VERSION_gstreamer1.0              = "1.14.4.imx"

BBMASK += "\
    meta-boot2qt/meta-fsl-extras/recipes/u-boot/u-boot-toradex_%.bbappend \
    meta-freescale/recipes-graphics/drm/libdrm_%.bbappend \
    imx/meta-bsp/recipes-browser \
    imx/meta-sdk/recipes-fsl/fsl-rc-local \
    imx/meta-sdk/recipes-fsl/images \
    imx/meta-sdk/recipes-fsl/packagegroup/packagegroup-fsl-gstreamer1.0.bbappend \
    imx/meta-sdk/recipes-fsl/packagegroup/packagegroup-fsl-tools-gpu.bbappend \
    imx/meta-sdk/recipes-fsl/packagegroup/packagegroup-fsl-tools-testapps.bbappend \
    imx/meta-sdk/recipes-graphics/devil \
    imx/meta-sdk/dynamic-layers/qt5-layer \
    "

KERNEL_MODULE_PACKAGE_SUFFIX ?= "-${@d.getVar('KERNEL_VERSION').replace('_','-')}"

WKS_FILE = "imx8-uboot-bootpart.wks.in"
WIC_CREATE_EXTRA_ARGS = "--no-fstab-update"
WKS_FILE_DEPENDS += "imx-boot"

IMAGE_BOOT_FILES = "\
    Image \
    fsl-*.dtb \
    "
```

## meta-boot2qt-distro/conf/distro/include/fsl.inc
```bitbake
############################################################################
##
## Copyright (C) 2021 The Qt Company Ltd.
## Contact: https://www.qt.io/licensing/
##
## This file is part of the Boot to Qt meta layer.
##
## $QT_BEGIN_LICENSE:GPL$
## Commercial License Usage
## Licensees holding valid commercial Qt licenses may use this file in
## accordance with the commercial license agreement provided with the
## Software or, alternatively, in accordance with the terms contained in
## a written agreement between you and The Qt Company. For licensing terms
## and conditions see https://www.qt.io/terms-conditions. For further
## information use the contact form at https://www.qt.io/contact-us.
##
## GNU General Public License Usage
## Alternatively, this file may be used under the terms of the GNU
## General Public License version 3 or (at your option) any later version
## approved by the KDE Free Qt Foundation. The licenses are as published by
## the Free Software Foundation and appearing in the file LICENSE.GPL3
## included in the packaging of this file. Please review the following
## information to ensure the GNU General Public License requirements will
## be met: https://www.gnu.org/licenses/gpl-3.0.html.
##
## $QT_END_LICENSE$
##
############################################################################

DEPLOY_CONF_NAME:imx6qdlsabresd = "NXP i.MX6QP/Q/DL SABRE Smart Device"
DEPLOY_CONF_NAME:imx7dsabresd = "NXP SABRE SD i.MX7 Dual"
DEPLOY_CONF_NAME:imx8mm-ddr4-evk = "NXP i.MX 8M Mini DDR4 EVK"
DEPLOY_CONF_NAME:imx8mm-lpddr4-evk = "NXP i.MX 8M Mini LPDDR4 EVK"
DEPLOY_CONF_NAME:imx8mn-ddr4-evk = "NXP i.MX 8M Nano DDR4 EVK"
DEPLOY_CONF_NAME:imx8mn-lpddr4-evk = "NXP i.MX 8M Nano LPDDR4 EVK"
DEPLOY_CONF_NAME:imx8mq-evk = "NXP i.MX 8MQuad EVK"
DEPLOY_CONF_NAME:imx8qm-mek = "NXP i.MX 8QuadMax MEK"
DEPLOY_CONF_NAME:imx8qpx-mek = "NXP i.MX 8QuadXPlus MEK"

IMAGE_FSTYPES += "wic.xz"

IMX_DEFAULT_BSP = "nxp"
IMX_DEFAULT_KERNEL:b2qt = "linux-imx"

DEPLOY_CONF_IMAGE_TYPE = "wic.xz"

QBSP_IMAGE_CONTENT += "\
    ${IMAGE_LINK_NAME}.${DEPLOY_CONF_IMAGE_TYPE} \
    ${IMAGE_LINK_NAME}.conf \
    ${IMAGE_LINK_NAME}.info \
    "

QBSP_LICENSE_FILE ?= "${FSL_EULA_FILE}"
QBSP_LICENSE_NAME ?= "NXP Semiconductors Software License Agreement"

# Use gstreamer from meta-freescale
PREFERRED_VERSION_gstreamer1.0:use-nxp-bsp      ?= "1.18.0.imx"
PREFERRED_VERSION_gstreamer1.0-plugins-base:use-nxp-bsp ?= "1.18.0.imx"
PREFERRED_VERSION_gstreamer1.0-plugins-good:use-nxp-bsp ?= "1.18.0.imx"
PREFERRED_VERSION_gstreamer1.0-plugins-bad:use-nxp-bsp  ?= "1.18.0.imx"
PREFERRED_VERSION_gstreamer1.0-plugins-ugly:use-nxp-bsp ?= "1.18.0"
PREFERRED_VERSION_gstreamer1.0-libav:use-nxp-bsp        ?= "1.18.0"
PREFERRED_VERSION_gstreamer1.0-rtsp-server:use-nxp-bsp  ?= "1.18.0"

MACHINE_GSTREAMER_1_0_PLUGIN:append:imxgpu = " imx-gst1.0-plugin"

# temporarily disable qca9377 from imx8mm machines
MACHINE_FEATURES:remove:mx8mm = "qca9377"
```

## meta-boot2qt-distro/conf/distro/include/jetson.inc
```bitbake
############################################################################
##
## Copyright (C) 2019 The Qt Company Ltd.
## Contact: https://www.qt.io/licensing/
##
## This file is part of the Boot to Qt meta layer.
##
## $QT_BEGIN_LICENSE:GPL$
## Commercial License Usage
## Licensees holding valid commercial Qt licenses may use this file in
## accordance with the commercial license agreement provided with the
## Software or, alternatively, in accordance with the terms contained in
## a written agreement between you and The Qt Company. For licensing terms
## and conditions see https://www.qt.io/terms-conditions. For further
## information use the contact form at https://www.qt.io/contact-us.
##
## GNU General Public License Usage
## Alternatively, this file may be used under the terms of the GNU
## General Public License version 3 or (at your option) any later version
## approved by the KDE Free Qt Foundation. The licenses are as published by
## the Free Software Foundation and appearing in the file LICENSE.GPL3
## included in the packaging of this file. Please review the following
## information to ensure the GNU General Public License requirements will
## be met: https://www.gnu.org/licenses/gpl-3.0.html.
##
## $QT_END_LICENSE$
##
############################################################################

INITRAMFS_MAXSIZE = "165888"
IMAGE_CLASSES += "image_types_tegra"
IMAGE_FSTYPES += "tegraflash"
IMAGE_ROOTFS_ALIGNMENT = "1024"
UBOOT_SUFFIX = "bin"

QBSP_IMAGE_CONTENT = "\
    ${IMAGE_LINK_NAME}.img \
    ${IMAGE_LINK_NAME}.conf \
    ${IMAGE_LINK_NAME}.flasher.tar.gz \
    "

# NVIDIA's Vulkan support is for X only
DISTRO_FEATURES_remove = "vulkan"

# https://github.com/madisongh/meta-tegra/issues/236
KERNEL_MODULE_AUTOLOAD_remove = "tegra-udrm"
KERNEL_MODULE_PROBECONF_remove = "tegra-udrm"
module_conf_tegra-udrm = ""

NVIDIA_DEVNET_MIRROR ?= "file://${BSPDIR}/sources/nvidia-devnet-mirror"
NVIDIA_DEVNET_MIRROR[vardepsexclude] = "BSPDIR"
```

## meta-boot2qt-distro/conf/distro/include/machine-settings.inc
```bitbake
############################################################################
##
## Copyright (C) 2021 The Qt Company Ltd.
## Contact: https://www.qt.io/licensing/
##
## This file is part of the Boot to Qt meta layer.
##
## $QT_BEGIN_LICENSE:GPL$
## Commercial License Usage
## Licensees holding valid commercial Qt licenses may use this file in
## accordance with the commercial license agreement provided with the
## Software or, alternatively, in accordance with the terms contained in
## a written agreement between you and The Qt Company. For licensing terms
## and conditions see https://www.qt.io/terms-conditions. For further
## information use the contact form at https://www.qt.io/contact-us.
##
## GNU General Public License Usage
## Alternatively, this file may be used under the terms of the GNU
## General Public License version 3 or (at your option) any later version
## approved by the KDE Free Qt Foundation. The licenses are as published by
## the Free Software Foundation and appearing in the file LICENSE.GPL3
## included in the packaging of this file. Please review the following
## information to ensure the GNU General Public License requirements will
## be met: https://www.gnu.org/licenses/gpl-3.0.html.
##
## $QT_END_LICENSE$
##
############################################################################

MACHINE_FAMILY ??= "empty"
MACHINE_FAMILY:imx = "fsl"
MACHINE_FAMILY:intel-x86-common = "intel"
MACHINE_FAMILY:qemuall = "qemu"
MACHINE_FAMILY:rpi = "raspberrypi"
MACHINE_FAMILY:tegra = "jetson"

# Toradex has no overrides that would distinguish them from other nxp boards
MACHINE_FAMILY:apalis-imx6 = "toradex"
MACHINE_FAMILY:apalis-imx8 = "toradex"
MACHINE_FAMILY:colibri-imx6 = "toradex"
MACHINE_FAMILY:colibri-imx6ull = "toradex"
MACHINE_FAMILY:colibri-imx7 = "toradex"
MACHINE_FAMILY:colibri-imx7-emmc = "toradex"
MACHINE_FAMILY:colibri-imx8x = "toradex"
MACHINE_FAMILY:verdin-imx8mm = "toradex"
MACHINE_FAMILY:verdin-imx8mp = "toradex"

# Variscite
MACHINE_FAMILY:imx8mm-var-dart = "variscite"
MACHINE_FAMILY:imx8mn-var-som = "variscite"
MACHINE_FAMILY:imx8mp-var-dart = "variscite"
MACHINE_FAMILY:imx8mq-var-dart = "variscite"
MACHINE_FAMILY:imx8qm-var-som = "variscite"
MACHINE_FAMILY:imx8qxp-var-som = "variscite"
MACHINE_FAMILY:imx8qxpb0-var-som = "variscite"

include conf/distro/include/${MACHINE_FAMILY}.inc
include conf/distro/include/${MACHINE}.inc

# prefer .inc, but include .conf for backwards compatibility
include conf/distro/include/${MACHINE}.conf
```
